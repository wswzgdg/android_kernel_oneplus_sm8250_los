// camera/kona-camera-sensor-mtp.dtsi
&camera_vana1_ldo {
    gpio = <&tlmm 117 0>;
};

&camera_vana2_ldo {
    gpio = <&tlmm 116 0>;
};

// kona-mtp.dtsi
&qupv3_se16_i2c {
    stm8s_fastcg@26 {
        qcom,charging_clock-gpio = <&tlmm 131 0x00>;
		qcom,charging_data-gpio = <&tlmm 129 0x00>;
    };
};
