/dts-v1/;

#include "kona.dtsi"
#include "bladerunner-48m.dtsi"

/ {
	model = "Qualcomm Technologies, Inc. kona v1 SoC";
	compatible = "qcom,kona";
	qcom,board-id = <0 0>;
	oplus,dtsi_no = <20607>;
};
