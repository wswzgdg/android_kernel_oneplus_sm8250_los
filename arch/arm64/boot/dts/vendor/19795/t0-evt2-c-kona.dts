/dts-v1/;

#include "kona.dtsi"
#include "bladerunnerc-t0-evt2.dtsi"

/ {
	model = "Qualcomm Technologies, Inc. kona v1 SoC";
	compatible = "qcom,kona";
	qcom,board-id = <0 0>;
	oplus,dtsi_no = <19795>;
	oplus,pcb_range = <0  26>;
};
